## CMakeLists.txt
```
#SPDX - License - Identifier : Apache - 2.0

cmake_minimum_required(VERSION 3.20.0)

find_package(Zephyr REQUIRED HINTS $ENV{ZEPHYR_BASE}) 
project(ir_recorder)

target_sources(app PRIVATE src/main.c src/nec.c) 
target_include_directories(app PRIVATE inc)
```

## prj.conf
```kconfig
CONFIG_SHELL=y 
CONFIG_GPIO=y 
CONFIG_SYS_CLOCK_TICKS_PER_SEC=1000000
CONFIG_LOG=y
```

## boards/stm32f4_disco.overlay
```dts
/*
 * Copyright (c) David Ullmann
 *
 * SPDX-License-Identifier: Apache-2.0
 */

#include "zephyr/dt-bindings/gpio/gpio.h"

/ {
    aliases {
        ir-receiver = &ir_receiver_gpio;
    };

    gpio_keys {
        compatible = "gpio-keys";
        ir_receiver_gpio: ir_receiver_gpio {
            gpios = <&gpiod 8 GPIO_ACTIVE_LOW>;
        };
    };
};
```

## src/main.c
```c
/*
 * Copyright (c) David Ullmann
 *
 * SPDX-License-Identifier: Apache-2.0
 */

#include "zephyr/drivers/gpio.h"
#include "zephyr/dt-bindings/gpio/gpio.h"
#include <stdint.h>
#include <stdio.h>
#include <zephyr/device.h>
#include <zephyr/devicetree.h>
#include <zephyr/kernel.h>
#include <zephyr/shell/shell.h>
#include <nec.h>
#include <zephyr/logging/log.h>

#define USECS_PER_SEC 1000U * 1000U

#define RECEIVER_NODE DT_ALIAS(ir_receiver)
#if !DT_NODE_HAS_STATUS(RECEIVER_NODE, okay)
#error "Unsupported board: ir-receiver devicetree alias is not defined"
#endif

static const struct gpio_dt_spec ir_receiver = GPIO_DT_SPEC_GET(RECEIVER_NODE, gpios);

LOG_MODULE_REGISTER(ir, LOG_LEVEL_INF);

const nec_protocol_t necext_protocol = {
	.address_num_bits = 16U,
	.command_num_bits = 16U,
	.addr_verify_inverse = false,
	.cmd_verify_inverse = false,
	.start_symbol =
		{
			.pulse_usecs = 9U * 1000U,
			.period_usecs = 13500U,
		},
	.stop_symbol_pulse_usecs = 562U,
	.data_bit_pulse_usecs = 562U,
	.zero_symbol_period_usecs = 562U * 2,
	.one_symbol_period_usecs = 562U + 1687U,
};

const nec_platform_t platform = {
	.usecs_tolerance = 75U,
};

int main(void)
{
	int err = 0;

	if (!gpio_is_ready_dt(&ir_receiver)) {
		LOG_ERR("reciever pin not ready.");
		return err;
	}

	err = gpio_pin_configure_dt(&ir_receiver, ir_receiver.dt_flags | GPIO_INPUT);
	if (err) {
		LOG_ERR("error configurint reciever pin. err = %d", err);
		return err;
	}
	return 0;
}

uint64_t get_timestamp_usecs()
{
	return k_uptime_ticks() * USECS_PER_SEC / CONFIG_SYS_CLOCK_TICKS_PER_SEC;
}

static int record_handler(const struct shell *sh, size_t argc, char **argv)
{
	nec_err_t err = NEC_ERR_NONE;
	bool gpio_val = false;
	uint64_t timestamp_usecs = 0;

	nec_state_t state;
	err = nec_init_state(&state);
	if (NEC_ERR_NONE != err) {
		shell_print(sh, "error initializing state: %u", err);
		return err;
	}

	while (NEC_STAGE_FINISHED != state.stage) {
		timestamp_usecs = get_timestamp_usecs();
		gpio_val = gpio_pin_get_dt(&ir_receiver);
		err = nec_process_sample(&state, &necext_protocol, &platform, gpio_val,
					 timestamp_usecs);
		if (NEC_ERR_NONE != err) {
			shell_print(sh, "error decoding signal. stage = %u, err = %u", state.stage,
				    err);
			return err;
		}
	}

	shell_print(sh, "addr: 0x%X, cmd: 0x%X", state.addr, state.cmd);
	return err;
}

SHELL_CMD_REGISTER(record, NULL, "record IR signal", record_handler);
```

## inc/nec.h
```c
#include <stdbool.h>
#include <stdint.h>
#include <sys/_stdint.h>

// TODO: maybe add repeat codes
typedef struct {
	const uint32_t address_num_bits;
	const uint32_t command_num_bits;
	const struct {
		uint32_t pulse_usecs;
		uint32_t period_usecs;
	} start_symbol;
	const uint32_t stop_symbol_pulse_usecs;
	const uint32_t data_bit_pulse_usecs;
	const uint32_t zero_symbol_period_usecs;
	const uint32_t one_symbol_period_usecs;
	const bool addr_verify_inverse;
	const bool cmd_verify_inverse;
} nec_protocol_t;

typedef struct {
	uint32_t usecs_tolerance;
} nec_platform_t;

typedef enum {
	NEC_STAGE_IDLE = 0,
	NEC_STAGE_START_SYMBOL,
	NEC_STAGE_ADDR,
	NEC_STAGE_ADDR_INV,
	NEC_STAGE_CMD,
	NEC_STAGE_CMD_INV,
	NEC_STAGE_STOP_SYMBOL,
	NEC_STAGE_FINISHED,
	NEC_STAGE_MAX = NEC_STAGE_FINISHED,
} nec_stage_t;

typedef struct {
	nec_stage_t stage;
	uint32_t bit_idx;
	uint64_t symbol_start_usecs;
	uint32_t addr;
	uint32_t cmd;
	uint32_t inv_addr;
	uint32_t inv_cmd;
} nec_state_t;

typedef enum {
	NEC_ERR_NONE = 0,
	NEC_ERR_STATE_NULL,
	NEC_ERR_PROTOCOL_NULL,
	NEC_ERR_PLATFORM_NULL,
	NEC_ERR_INVALID_STAGE,
	NEC_ERR_PULSE_TOO_SHORT,
	NEC_ERR_UNEXPECTED_LINE_HIGH,
	NEC_ERR_SYMBOL_PERIOD_TOO_LONG,
} nec_err_t;

nec_err_t nec_init_state(nec_state_t *state);

nec_err_t nec_process_sample(nec_state_t *state, const nec_protocol_t *protocol,
			     const nec_platform_t *platform, bool sample, uint64_t timestamp_usecs);
```

## src/nec.c
```c
#include <nec.h>
#include <stdbool.h>
#include <stdlib.h>
#include <assert.h>

typedef nec_err_t (*_nec_stage_handler_t)(nec_state_t *state, const nec_protocol_t *protocol,
					  const nec_platform_t *platform, bool sample,
					  uint64_t timestamp);

static nec_err_t nec_handle_idle(nec_state_t *state, const nec_protocol_t *protocol,
				 const nec_platform_t *platform, bool sample, uint64_t timestamp);

static nec_err_t nec_handle_start_symbol(nec_state_t *state, const nec_protocol_t *protocol,
					 const nec_platform_t *platform, bool sample,
					 uint64_t timestamp);

static nec_err_t nec_handle_addr(nec_state_t *state, const nec_protocol_t *protocol,
				 const nec_platform_t *platform, bool sample, uint64_t timestamp);

static nec_err_t nec_handle_cmd(nec_state_t *state, const nec_protocol_t *protocol,
				const nec_platform_t *platform, bool sample, uint64_t timestamp);

static nec_err_t nec_handle_stop_symbol(nec_state_t *state, const nec_protocol_t *protocol,
					const nec_platform_t *platform, bool sample,
					uint64_t timestamp);

static nec_err_t handle_generic_zero_one_symbol(const nec_protocol_t *protocol,
						const nec_platform_t *platform, bool sample,
						uint64_t symbol_elapsed_usecs, bool *bit_out,
						bool *symbol_complete);

const _nec_stage_handler_t _stage_handlers[] = {
	[NEC_STAGE_IDLE] = nec_handle_idle,
	[NEC_STAGE_START_SYMBOL] = nec_handle_start_symbol,
	[NEC_STAGE_ADDR] = nec_handle_addr,
	[NEC_STAGE_ADDR_INV] = NULL,
	[NEC_STAGE_CMD] = nec_handle_cmd,
	[NEC_STAGE_CMD_INV] = NULL,
	[NEC_STAGE_STOP_SYMBOL] = nec_handle_stop_symbol,
	[NEC_STAGE_FINISHED] = NULL,
};

nec_err_t nec_init_state(nec_state_t *state)
{
	state->stage = NEC_STAGE_IDLE;
	state->bit_idx = 0;
	state->symbol_start_usecs = 0;
	state->addr = 0;
	state->cmd = 0;
	state->inv_addr = 0;
	state->inv_cmd = 0;
	return NEC_ERR_NONE;
}

nec_err_t nec_process_sample(nec_state_t *state, const nec_protocol_t *protocol,
			     const nec_platform_t *platform, bool sample, uint64_t timestamp)
{
	_nec_stage_handler_t handler = NULL;
	if (NULL == state) {
		return NEC_ERR_STATE_NULL;
	}

	if (NULL == protocol) {
		return NEC_ERR_PROTOCOL_NULL;
	}

	if (NULL == platform) {
		return NEC_ERR_PLATFORM_NULL;
	}

	if (state->stage > NEC_STAGE_MAX) {
		return NEC_ERR_INVALID_STAGE;
	}

	handler = _stage_handlers[state->stage];
	assert(NULL != handler);

	return handler(state, protocol, platform, sample, timestamp);
}

nec_err_t nec_handle_idle(nec_state_t *state, const nec_protocol_t *protocol,
			  const nec_platform_t *platform, bool sample, uint64_t timestamp)
{
	if (!sample) {
		return NEC_ERR_NONE;
	}

	state->stage = NEC_STAGE_START_SYMBOL;
	state->symbol_start_usecs = timestamp;
	return NEC_ERR_NONE;
}

nec_err_t nec_handle_start_symbol(nec_state_t *state, const nec_protocol_t *protocol,
				  const nec_platform_t *platform, bool sample, uint64_t timestamp)
{
	uint32_t elapsed_usecs = timestamp - state->symbol_start_usecs;
	uint32_t min_pulse = protocol->start_symbol.pulse_usecs - platform->usecs_tolerance;
	uint32_t max_pulse = protocol->start_symbol.pulse_usecs + platform->usecs_tolerance;
	uint32_t min_period = protocol->start_symbol.period_usecs - platform->usecs_tolerance;
	uint32_t max_period = protocol->start_symbol.period_usecs + platform->usecs_tolerance;

	if (elapsed_usecs < min_pulse) {
		if (!sample) {
			return NEC_ERR_PULSE_TOO_SHORT;
		}
	} else if (elapsed_usecs < max_pulse) {
	} else if (elapsed_usecs < min_period) {
		if (sample) {
			return NEC_ERR_UNEXPECTED_LINE_HIGH;
		}
	} else if (elapsed_usecs < max_period) {
		if (sample) {
			state->symbol_start_usecs = timestamp;
			state->stage = NEC_STAGE_ADDR;
		}
	} else if (elapsed_usecs > max_period) {
		return NEC_ERR_SYMBOL_PERIOD_TOO_LONG;
	}

	return NEC_ERR_NONE;
}

nec_err_t nec_handle_addr(nec_state_t *state, const nec_protocol_t *protocol,
			  const nec_platform_t *platform, bool sample, uint64_t timestamp)
{
	uint32_t elapsed_usecs = timestamp - state->symbol_start_usecs;
	bool value;
	bool complete = false;
	nec_err_t err = handle_generic_zero_one_symbol(protocol, platform, sample, elapsed_usecs,
						       &value, &complete);
	if (NEC_ERR_NONE != err || !complete) {
		return err;
	}

	if (value) {
		state->addr |= (1U << state->bit_idx++);
	} else {
		state->addr &= ~(1U << state->bit_idx++);
	}

	if (state->bit_idx == protocol->address_num_bits) {
		state->stage = protocol->addr_verify_inverse ? NEC_STAGE_ADDR_INV : NEC_STAGE_CMD;
		state->bit_idx = 0;
	}

	state->symbol_start_usecs = timestamp;
	return err;
}

nec_err_t nec_handle_cmd(nec_state_t *state, const nec_protocol_t *protocol,
			 const nec_platform_t *platform, bool sample, uint64_t timestamp)
{

	uint32_t elapsed_usecs = timestamp - state->symbol_start_usecs;
	bool value;
	bool complete;
	nec_err_t err = handle_generic_zero_one_symbol(protocol, platform, sample, elapsed_usecs,
						       &value, &complete);
	if (NEC_ERR_NONE != err || !complete) {
		return err;
	}

	if (value) {
		state->cmd |= (1U << state->bit_idx++);
	} else {
		state->cmd &= ~(1U << state->bit_idx++);
	}

	if (state->bit_idx == protocol->command_num_bits) {
		state->stage =
			protocol->addr_verify_inverse ? NEC_STAGE_CMD_INV : NEC_STAGE_STOP_SYMBOL;
		state->bit_idx = 0;
	}

	state->symbol_start_usecs = timestamp;
	return err;
}

static nec_err_t nec_handle_stop_symbol(nec_state_t *state, const nec_protocol_t *protocol,
					const nec_platform_t *platform, bool sample,
					uint64_t timestamp)
{

	uint32_t pulse_min = protocol->stop_symbol_pulse_usecs - platform->usecs_tolerance;
	uint32_t pulse_max = protocol->stop_symbol_pulse_usecs + platform->usecs_tolerance;
	uint32_t elapsed_usecs = timestamp - state->symbol_start_usecs;
	if (elapsed_usecs < pulse_min) {
		if (!sample) {
			return NEC_ERR_PULSE_TOO_SHORT;
		}
	} else if (elapsed_usecs < pulse_max) {
		if (!sample) {
			state->stage = NEC_STAGE_FINISHED;
		}
	} else {
		if (sample) {
			return NEC_ERR_UNEXPECTED_LINE_HIGH;
		}
	}
	return NEC_ERR_NONE;
}

nec_err_t handle_generic_zero_one_symbol(const nec_protocol_t *protocol,
					 const nec_platform_t *platform, bool sample,
					 uint64_t symbol_elapsed_usecs, bool *bit_out,
					 bool *symbol_complete)
{
	*symbol_complete = 0;

	uint32_t pulse_min = protocol->data_bit_pulse_usecs - platform->usecs_tolerance;
	uint32_t pulse_max = protocol->data_bit_pulse_usecs + platform->usecs_tolerance;

	uint32_t shorter_symbol_period;
	uint32_t longer_symbol_period;
	bool symbol_with_shorter_period_value;
	bool symbol_with_longer_period_value;
	if (protocol->zero_symbol_period_usecs < protocol->one_symbol_period_usecs) {
		shorter_symbol_period = protocol->zero_symbol_period_usecs;
		longer_symbol_period = protocol->one_symbol_period_usecs;
		symbol_with_shorter_period_value = false;
		symbol_with_longer_period_value = true;
	} else {
		shorter_symbol_period = protocol->one_symbol_period_usecs;
		longer_symbol_period = protocol->zero_symbol_period_usecs;
		symbol_with_shorter_period_value = false;
		symbol_with_longer_period_value = true;
	}

	uint32_t shorter_period_min = shorter_symbol_period - platform->usecs_tolerance;
	uint32_t shorter_period_max = shorter_symbol_period + platform->usecs_tolerance;
	uint32_t longer_period_min = longer_symbol_period - platform->usecs_tolerance;
	uint32_t longer_period_max = longer_symbol_period + platform->usecs_tolerance;
	if (symbol_elapsed_usecs < pulse_min) {
		if (!sample) {
			return NEC_ERR_PULSE_TOO_SHORT;
		}
	} else if (symbol_elapsed_usecs < pulse_max) {

	} else if (symbol_elapsed_usecs < shorter_period_min) {
		if (sample) {
			return NEC_ERR_UNEXPECTED_LINE_HIGH;
		}
	} else if (symbol_elapsed_usecs < shorter_period_max) {
		if (sample) {
			*symbol_complete = true;
			*bit_out = symbol_with_shorter_period_value;
		}
	} else if (symbol_elapsed_usecs < longer_period_min) {
		if (sample) {
			return NEC_ERR_UNEXPECTED_LINE_HIGH;
		}
	} else if (symbol_elapsed_usecs < longer_period_max) {
		if (sample) {
			*symbol_complete = true;
			*bit_out = symbol_with_longer_period_value;
		}
	} else if (symbol_elapsed_usecs > longer_period_max) {
		return NEC_ERR_SYMBOL_PERIOD_TOO_LONG;
	}
	return NEC_ERR_NONE;
}
```
